## main/Kconfig.projbuild
```kconfig
menu "Dashcam"

    config DASHCAM_HOSTNAME
        string "Hostname (mDNS name without .local)"
        default "dashcam"

    config DASHCAM_AP_PASSWORD
        string "Initial access point password"
        default ""
        help
            WPA2 password (8+ characters) used for the device's own access point
            until it is changed from the web UI. Empty or shorter values make the
            access point open.

    config DASHCAM_WIFI_SSID
        string "Initial Wi-Fi SSID to join"
        default ""

    config DASHCAM_WIFI_PASSWORD
        string "Initial Wi-Fi password"
        default ""

    config DASHCAM_ENABLE_UVC
        bool "Expose the camera as a USB webcam (UVC)"
        default y
        help
            When enabled, the USB port becomes a UVC webcam and the built-in
            USB-Serial/JTAG port disappears. Use the web UI "maintenance reboot",
            hold the BOOT button for 3 seconds, or use OTA to update firmware.

endmenu
```

## sdkconfig.defaults
```kconfig
CONFIG_IDF_TARGET="esp32s3"

# XIAO ESP32S3 Sense: 8 MB flash, 8 MB octal PSRAM
CONFIG_ESPTOOLPY_FLASHSIZE_8MB=y
CONFIG_ESPTOOLPY_FLASHMODE_QIO=y
CONFIG_ESPTOOLPY_FLASHFREQ_80M=y
CONFIG_PARTITION_TABLE_CUSTOM=y
CONFIG_PARTITION_TABLE_CUSTOM_FILENAME="partitions.csv"
CONFIG_SPIRAM=y
CONFIG_SPIRAM_MODE_OCT=y
CONFIG_SPIRAM_SPEED_80M=y
CONFIG_SPIRAM_USE_MALLOC=y
CONFIG_SPIRAM_MALLOC_ALWAYSINTERNAL=4096
CONFIG_SPIRAM_MALLOC_RESERVE_INTERNAL=65536
CONFIG_SPIRAM_TRY_ALLOCATE_WIFI_LWIP=y

CONFIG_ESP_DEFAULT_CPU_FREQ_MHZ_240=y
CONFIG_COMPILER_OPTIMIZATION_PERF=y
CONFIG_FREERTOS_HZ=1000
CONFIG_ESP_MAIN_TASK_STACK_SIZE=8192
CONFIG_BOOTLOADER_APP_ROLLBACK_ENABLE=y

# Web server / sockets
CONFIG_LWIP_MAX_SOCKETS=16
CONFIG_HTTPD_MAX_REQ_HDR_LEN=1024
CONFIG_HTTPD_MAX_URI_LEN=512

# SD card: long file names
CONFIG_FATFS_LFN_HEAP=y
CONFIG_FATFS_MAX_LFN=255

# USB webcam (UVC): single 1280x720 MJPEG format
CONFIG_TUSB_MANUFACTURER="Seeed XIAO"
CONFIG_TUSB_PRODUCT="XIAO Dashcam"
CONFIG_FORMAT_MJPEG_CAM1=y
CONFIG_UVC_MODE_ISOC_CAM1=y
CONFIG_FRAMESIZE_HD=y
CONFIG_UVC_CAM1_FRAMERATE=15
# CONFIG_UVC_CAM1_MULTI_FRAMESIZE is not set
```
